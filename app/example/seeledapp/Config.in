## app/example/seeledapp/Config.in
```kconfig
config AOS_APP_SEELEDAPP
    bool "Seeledapp Application"
    select AOS_COMP_CLI if !AOS_BOARD_ESP8266
    select AOS_COMP_NETMGR
    select AOS_COMP_OTA
    select AOS_COMP_CJSON
    select AOS_COMP_LINKKIT_SDK_C
    select APP_FEATURE_LINKKIT
    select AOS_COMP_CJSON
    select AOS_COMP_BREEZE if SEELEDAPP_CONFIG_COMBOAPP
    select AOS_COMP_BREEZE_HAL if SEELEDAPP_CONFIG_COMBOAPP
    help
        seeledapp

if AOS_APP_SEELEDAPP
# Configurations for app seeledapp
config SEELEDAPP_CONFIG_COMBOAPP
    bool "Enable Breeze AWSS "
    default n
    help 
        Providing secured ble link for wifi provision.

choice
    prompt "Select Case"
    default SEELEDAPP_CONFIG_CASE_SOLO
    help
        select case to build

    config SEELEDAPP_CONFIG_CASE_SOLO
        bool "SOLO"
        help
            default case, build linkkit_example_solo.c or deprecated/solo.c(when enable deprecated)

    config SEELEDAPP_CONFIG_CASE_SCHED
        bool "Sched"
        help
            case sched, build linkkit_example_sched.c or deprecated/sched.c(when enable deprecated)

    config SEELEDAPP_CONFIG_CASE_CNTDOWN
        bool "Cntdown"
        help
            case countdown, build linkkit_example_cntdown.c or deprecated/cntdown.c(when enable deprecated)
endchoice

config SEELEDAPP_CONFIG_DEPRECATED
    bool "Use Deprecated API"
    default n
    help
    use deprecated api,compatible with aos2.0 and earlier, not recommended

config SEELEDAPP_CONFIG_PRINT_HEAP
    bool "Show Free Heap Duration"
    default n
    help
    displays heap space periodically for debug
endif
```

## application/example/example_legacy/seeledapp/Config.in
```kconfig
config AOS_APP_SEELEDAPP
    bool "Seeledapp Application"
    select AOS_COMP_CLI if !AOS_BOARD_ESP8266
    select AOS_COMP_NETMGR
    select AOS_COMP_CJSON
    select AOS_COMP_SDK_DEVMODEL
    select AOS_COMP_CJSON
    select AOS_COMP_SDK_AWSS
    select AOS_COMP_BREEZE if SEELEDAPP_CONFIG_COMBOAPP
    help
        seeledapp

if AOS_APP_SEELEDAPP
# Configurations for app seeledapp
config SEELEDAPP_CONFIG_COMBOAPP
    bool "Enable Breeze AWSS "
    default n
    help 
        Providing secured ble link for wifi provision.

config ENABLE_OTA
    bool "Enable OTA"
    default y
    select AOS_COMP_OTA
    help 
        enable feature OTA.

choice
    prompt "Select Case"
    default SEELEDAPP_CONFIG_CASE_SOLO
    help
        select case to build

    config SEELEDAPP_CONFIG_CASE_SOLO
        bool "SOLO"
        help
            default case, build linkkit_example_solo.c or deprecated/solo.c(when enable deprecated)

    config SEELEDAPP_CONFIG_CASE_SCHED
        bool "Sched"
        help
            case sched, build linkkit_example_sched.c or deprecated/sched.c(when enable deprecated)

    config SEELEDAPP_CONFIG_CASE_CNTDOWN
        bool "Cntdown"
        help
            case countdown, build linkkit_example_cntdown.c or deprecated/cntdown.c(when enable deprecated)
endchoice

config SEELEDAPP_CONFIG_PRINT_HEAP
    bool "Show Free Heap Duration"
    default n
    help
    displays heap space periodically for debug
endif
```

## board/gokit3_soc/Config.in
```kconfig
config AOS_BOARD_GOKIT3_SOC
    bool "GOKIT3_SOC"
    select AOS_MCU_ESP8266
    select AOS_COMP_KERNEL_INIT
    help
        The ESP8266 integrates a Tensilica L106 32-bit RISC processor, which achieves extralow power consumption and reaches a maximum clock speed of 160 MHz. The Real-Time Operating System (RTOS) and Wi-Fi stack allow 80% of the processing power to be available for user application programming and development.

if AOS_BOARD_GOKIT3_SOC
# Configurations for board gokit3_soc

config DEBUG_CONFIG_PANIC
    bool "Enable debug panic feature"
    default y
    help
        set to y if you want to enable panic debug feature when system crash happened,
        default y

config DEBUG_CONFIG_BACKTRACE
    bool "Enable stack backtrace feature"
    default y
    help
        set to y if you want to enable stack backtrace feature when system crash happened,
        default y

config GOKIT3_BSP_RGBLED
    bool "Enable rgbled unit"
    default y
    help
        set to y if you want to use rgbled,
        default y

config GOKIT3_BSP_DHT11
    bool "Enable dht11 unit"
    default y
    help
        set to y if you want to use tem_hum,
        default y

config GOKIT3_BSP_INFRARED
    bool "Enable infrared unit"
    default y
    help
        set to y if you want to use infrared,
        default y

# "BSP SUPPORT FEATURE"
config BSP_SUPPORT_UART
    bool
    default y

config BSP_SUPPORT_GPIO
    bool
    default y

config BSP_SUPPORT_FLASH
    bool
    default y

config BSP_SUPPORT_BLE
    bool
    default y

endif
```
